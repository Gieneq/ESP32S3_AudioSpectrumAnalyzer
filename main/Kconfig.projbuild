## main/Kconfig.projbuild
```kconfig
menu "I2C Bus Scan"

    config SCAN_I2C_BUS_ON_STARTUP
        bool "Scan I2C bus"
        default n
        help
            During startup scan I2C bus to show visible slaves.
            
endmenu
```
